## boards/shields/mysplit/Kconfig.defconfig
```kconfig
# Defaults applied when building either half
if SHIELD_MYSPLIT_LEFT || SHIELD_MYSPLIT_RIGHT
config ZMK_SPLIT
    default y
endif

# Central on left half; sets device name and central role
if SHIELD_MYSPLIT_LEFT
config ZMK_KEYBOARD_NAME
    default "MySplit"

config ZMK_SPLIT_ROLE_CENTRAL
    default y
endif
```

## boards/shields/mysplit/Kconfig.shield
```kconfig
# No whitespace after the comma or in your part name!
config SHIELD_MYSPLIT_LEFT
    def_bool $(shields_list_contains,mysplit_left)

config SHIELD_MYSPLIT_RIGHT
    def_bool $(shields_list_contains,mysplit_right)
```
